# allwinner_d1_unofficial register map
File version: 0.1
Allwinner's D1 chip unofficial SVD file
Registers are 32-bit, read-write, reset 0x0 unless marked. A register's access mark holds for its fields unless they carry their own. Offsets are from the block's base; lines under a group give offsets from that group; [hi:lo] are bit positions; {n}, {i} and the like mark numbered series; 'fields as' and 'values as' point back to an identical list; <NAME> marks a mode.

## Memory map
0x01701000 DSP_MSGBOX size 0x1000 — DSP Message Box
0x02000000 GPIO size 0x800 — Gerneral Purpose Input/Output
0x02000C00 PWM size 0x400 — Pulse Width Modulation
0x02001000 CCU size 0x10000 — Clock Controller Unit
0x02003000 CIR_TX size 0x400 — Counsumer Infrared Transmitter
0x02008000 LEDC size 0x400
0x02009000 GPADC size 0x400 — General Purpose ADC
0x02009400 THC size 0x400 — Thermal Sensor Controller
0x02009800 LRADC size 0x400 — Low Rate ADC
0x02009C00 TPADC size 0x400 — Touch Panel ADC
0x02010000 IOMMU size 0x10000 — I/O Memory Management Unit
0x02030000 AudioCodec size 0x1000
0x02031000 DMIC size 0x400
0x02032000 I2S_PCM0 size 0x1000 — I2S/PCM
0x02033000 I2S_PCM1 size 0x1000 — I2S/PCM
0x02034000 I2S_PCM2 size 0x1000 — I2S/PCM
0x02036000 OWA size 0x400 — One Wire Audio
0x02050000 TIMER size 0x1000 — Timer Module, includes timer0, timer1, watchdog and audio video synchronization
0x02500000 UART0 size 0x400 — Universal Asynchronous Receiver Transmitter
0x02500400 UART1 size 0x400 — Universal Asynchronous Receiver Transmitter
0x02500800 UART2 size 0x400 — Universal Asynchronous Receiver Transmitter
0x02500C00 UART3 size 0x400 — Universal Asynchronous Receiver Transmitter
0x02501000 UART4 size 0x400 — Universal Asynchronous Receiver Transmitter
0x02501400 UART5 size 0x400 — Universal Asynchronous Receiver Transmitter
0x02502000 TWI0 size 0x400 — Two Wire Interface
0x02502400 TWI1 size 0x400 — Two Wire Interface
0x02502800 TWI2 size 0x400 — Two Wire Interface
0x02502C00 TWI3 size 0x400 — Two Wire Interface
0x03000000 SYS_CFG size 0x1000 — System Configuration
0x03002000 DMAC size 0x1000 — Direct Memory Access Controller
0x03005000 Spinlock size 0x1000
0x03008000 HSTimer size 0x1000 — High Speed Timer
0x03040000 CE_NS size 0x800 — Crypoto Engine
0x04020000 SMHC0 size 0x1000 — SD/MMC Host Controller
0x04021000 SMHC1 size 0x1000 — SD/MMC Host Controller
0x04022000 SMHC2 size 0x1000 — SD/MMC Host Controller
0x04025000 SPI0 size 0x1000 — Serial Peripheral Interface
0x04026000 SPI_DBI size 0x1000 — Serial Peripheral Interface Display Bus Interface
0x04100000 USB0 size 0x100000 — USB2.0 DRD
0x04200000 USB1 size 0x100000 — USB2.0 HOST
0x04500000 EMAC size 0x10000 — Ethernet Medium Access Controller
0x05461000 TCON_LCD0 size 0x1000 — Timing COntroller LCD
0x05470000 TCON_TV0 size 0x1000 — Timing COntroller TV
0x05600000 TVE_TOP size 0x4000 — TV Encoder TOP
0x05604000 TVE size 0x4000 — TV Encoder
0x05800000 CSIC size 0x400000 — CMOS Sensor Interface Controller
0x05C00000 TVD_TOP size 0x1000 — Television Decoder TOP
0x05C01000 TVD0 size 0x1000 — Television Decoder
0x06010000 RISCV_CFG size 0x1000 — RISC-V System Configuration
0x0601F000 RISC_V_MSGBOX size 0x1000 — RISC-V Message Box
0x07040000 CIR_RX size 0x400 — Counsumer Infrared Receiver
0x07090000 RTC size 0x1000 — Real Time CLock
0x10000000 PLIC — Platform Level Interrupt Control
0x14000000 CLINT size 0x10000 — Core-Local Interruptor

## Interrupts
18 UART0
19 UART1
20 UART2
21 UART3
22 UART4
23 UART5
25 TWI0
26 TWI1
27 TWI2
28 TWI3
31 SPI0
32 SPI1 (SPI_DBI)
34 PWM
35 IR_TX (CIR_TX)
36 LEDC
39 OWA
40 DMIC
41 AUDIO_CODEC (AudioCodec)
42 I2S_PCM0
43 I2S_PCM1
44 I2S_PCM2
45 USB0_DEVICE (USB0)
46 USB0_EHCI (USB0)
47 USB0_OHCI (USB0)
49 USB1_EHCI (USB1)
50 USB1_OHCI (USB1)
62 EMAC
66 DMAC_NS (DMAC)
68 CE_NS
70 SPINLOCK (Spinlock)
71 HSTIMER0 (HSTimer)
72 HSTIMER1 (HSTimer)
73 GPADC
74 THS (THC)
75 TIMER0 (TIMER)
76 TIMER1 (TIMER)
77 LRADC
78 TPADC
79 WATCHDOG (TIMER)
80 IOMMU
85 GPIOB_NS (GPIO)
87 GPIOC_NS (GPIO)
89 GPIOD_NS (GPIO)
91 GPIOE_NS (GPIO)
93 GPIOF_NS (GPIO)
111 CSI_DMA0 (CSIC)
112 CSI_DMA1 (CSIC)
122 CSI_TOP_PKT (CSIC)
123 TVD (TVD_TOP)
144 RISC-V_MBOX_RISC-V (RISC_V_MSGBOX)
145 RISC-V_MBOX_DSP (RISC_V_MSGBOX)
167 IR_RX (CIR_RX)
