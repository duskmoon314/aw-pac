# allwinner_d1_unofficial register map
File version: 0.1
Registers are 32-bit, read-write, reset 0x0 unless marked. A register's access mark holds for its fields unless they carry their own. Offsets are from the block's base; [hi:lo] are bit positions; {n}, {i} and the like mark numbered series.

## TVD0 — Television Decoder
Base 0x05C01000
0x00 TVD_EN — TVD MODULE CONTROL Register
0x04 TVD_MODE — TVD MODE CONTROL Register
0x08 TVD_CLAMP_AGC1 — TVD CLAMP And AGC CONTROL Register1
0x0C TVD_CLAMP_AGC2 — TVD CLAMP And AGC CONTROL Register2
{0xC+4i} TVD_HLOCK{i} (i=1..5) — TVD HLOCK CONTROL Register{i}
0x24 TVD_VLOCK1 — TVD VLOCK CONTROL Register1
0x28 TVD_VLOCK2 — TVD VLOCK CONTROL Register2
0x30 TVD_CLOCK1 — TVD CHROMA LOCK CONTROL Register1
0x34 TVD_CLOCK2 — TVD CHROMA LOCK CONTROL Register2
0x40 TVD_YC_SEP1 — TVD YC SEPERATION CONROL Register1
0x44 TVD_YC_SEP2 — TVD YC SEPERATION CONROL Register2
{0x4C+4i} TVD_ENHANCE{i} (i=1..3) — TVD ENHANCEMENT CONTROL Register{i}
{0x5C+4i} TVD_WB{i} (i=1..4) — TVD WB DMA CONTROL Register{i}
0x80 TVD_IRQ_CTL — TVD DMA Interrupt Control Register
0x90 TVD_IRQ_STATUS — TVD DMA Interrupt Status Register
0x100 TVD_DEBUG1 — TVD DEBUG CONTROL Register1
{0x17C+4i} TVD_STATUS{i} (i=1..6) — TVD DEBUG STATUS Register{i}

## I2S_PCM0 — I2S/PCM
Base 0x02032000
Same registers: I2S_PCM1 0x02033000, I2S_PCM2 0x02034000
0x00 I2S_PCM_CTL — I2S/PCM Control Register
0x04 I2S_PCM_FMT0 — I2S/PCM Format Register 0
0x08 I2S_PCM_FMT1 — I2S/PCM Format Register 1
0x0C I2S_PCM_ISTA — I2S/PCM Interrupt Status Register
0x10 I2S_PCM_RXFIFO
0x14 I2S_PCM_FCTL — I2S/PCM FIFO Control Register
0x18 I2S_PCM_FSTA — I2S/PCM FIFO Status Register
0x1C I2S_PCM_INT — I2S/PCM DMA and Interrupt Control Register
0x20 I2S_PCM_TXFIFO
0x24 I2S_PCM_CLKD — I2S/PCM Clock Divide Register
0x28 I2S_PCM_TXCNT — I2S/PCM TX Sample Counter Register
0x2C I2S_PCM_RXCNT — I2S/PCM RX Sample Counter Register
0x30 I2S_PCM_CHCFG — I2S/PCM Channel Configuration Register
{0x34+4i} I2S_PCM_TX{i}CHSEL (i=0..3) — I2S/PCM TX{i} Channel Select Register
{0x44+8i} I2S_PCM_TX{i}CHMAP0 (i=0..3) — I2S/PCM TX{i} Channel Mapping Register0
{0x48+8i} I2S_PCM_TX{i}CHMAP1 (i=0..3) — I2S/PCM TX{i} Channel Mapping Register1
0x64 I2S_PCM_RXCHSEL — I2S/PCM RX Channel Select Register
{0x68+4i} I2S_PCM_RXCHMAP{i} (i=0..3) — I2S/PCM RX Channel Mapping Register{i}
0x80 MCLKCFG — ASRC MCLK Configuration Register
0x84 FsoutCFG — ASRC Out Sample Rate Configuration Register
0x88 FsinEXTCFG — ASRC Input Sample Pulse Extend Configuration Register
0x8C ASRCCFG — ASRC Enable Register
0x90 ASRCMANCFG — ASRC Manual Ratio Configuration Register
0x94 ASRCRATIOSTAT — ASRC Status Register
0x98 ASRCFIFOSTAT — ASRC FIFO Level Status Register
0x9C ASRCMBISTCFG — ASRC MBIST Test Configuration Register
0xA0 ASRCMBISTSTAT — ASRC MBIST Test Status Register

## DMIC
Base 0x02031000
0x00 DMIC_EN — DMIC Enable Control Register
0x04 DMIC_SR — DMIC Sample Rate Register
0x08 DMIC_CTR — DMIC Control Register
0x10 DMIC_DATA
0x14 DMIC_INTC — DMIC Interrupt Control Register
0x18 DMIC_INTS — DMIC Interrupt Status Register
0x1C DMIC_RXFIFO_CTR — DMIC RXFIFO Control Register
0x20 DMIC_RXFIFO_STA — DMIC RXFIFO Status Register
0x24 DMIC_CH_NUM — DMIC Channel Numbers Register
0x28 DMIC_CH_MAP — DMIC Channel Mapping Register
0x2C DMIC_CNT — DMIC Counter Register
0x30 DATA0_DATA1_VOL_CTR — Data0 and Data1 Volume Control Register
0x34 DATA2_DATA3_VOL_CTR — Data2 And Data3 Volume Control Register
0x38 HPF_EN_CTR — High Pass Filter Enable Control Register
0x3C HPF_COEF_REG — High Pass Filter Coefficient Register
0x40 HPF_GAIN_REG — High Pass Filter Gain Register

## OWA — One Wire Audio
Base 0x02036000
0x00 OWA_GEN_CTL — OWA General Control Register
0x04 OWA_TX_CFIG — OWA TX Configuration Register
0x08 OWA_RX_CFIG — OWA RX Configuration Register
0x0C OWA_ISTA — OWA Interrupt Status Register
0x10 OWA_RXFIFO
0x14 OWA_FCTL — OWA FIFO Control Register
0x18 OWA_FSTA — OWA FIFO Status Register
0x1C OWA_INT — OWA Interrupt Control Register
0x20 OWA_TX_FIFO
0x24 OWA_TX_CNT — OWA TX Counter Register
0x28 OWA_RX_CNT — OWA RX Counter Register
0x2C OWA_TX_CHSTA0 — OWA TX Channel Status Register0
0x30 OWA_TX_CHSTA1 — OWA TX Channel Status Register1
0x34 OWA_RXCHSTA0 — OWA RX Channel Status Register0
0x38 OWA_RXCHSTA1 — OWA RX Channel Status Register1
0x40 OWA_EXP_CTL — OWA Expand Control Register
0x44 OWA_EXP_ISTA — OWA Expand Interrupt Status Register
0x48 OWA_EXP_INFO_0 — OWA Expand Infomation Register0
0x4C OWA_EXP_INFO_1 — OWA Expand Infomation Register1
0x50 OWA_EXP_DBG_0 — OWA Expand Debug Register0
0x54 OWA_EXP_DBG_1 — OWA Expand Debug Register1
