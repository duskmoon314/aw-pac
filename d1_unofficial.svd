# allwinner_d1_unofficial register map
File version: 0.1
Registers are 32-bit, read-write, reset 0x0 unless marked. A register's access mark holds for its fields unless they carry their own. Offsets are from the block's base; [hi:lo] are bit positions; {n}, {i} and the like mark numbered series.

## AudioCodec
Base 0x02030000
0x00 AC_DAC_DPC — DAC Digital Part Control Register
0x04 DAC_VOL_CTRL — DAC Volume Control Register
0x10 AC_DAC_FIFOC — DAC FIFO Control Register
0x14 AC_DAC_FIFOS — DAC FIFO Status Register
0x20 AC_DAC_TXDATA — DAC TX DATA Register
0x24 AC_DAC_CNT — DAC TX FIFO Counter Register
0x28 AC_DAC_DG — DAC Debug Register
0x30 AC_ADC_FIFOC — ADC FIFO Control Register
0x34 ADC_VOL_CTRL1 — ADC Volume Control1 Register
0x38 AC_ADC_FIFOS — ADC FIFO Status Register
0x40 AC_ADC_RXDATA — ADC RX Data Register
0x44 AC_ADC_CNT — ADC RX Counter Register
0x4C AC_ADC_DG — ADC Debug Register
0x50 ADC_DIG_CTRL — ADC Digtial Control Register
0x54 VRA1SPEEDUP_DOWN_CTRL — VRA1 Speedup Down Control Register
0xF0 AC_DAC_DAP_CTRL — DAC DAP Control Register
0xF8 AC_ADC_DAP_CTR — ADC DAP Control Register
0x100 AC_DAC_DRC_HHPFC — DAC DRC High HPF Coef Register
0x104 AC_DAC_DRC_LHPFC — DAC DRC Low HPF Coef Register
0x108 AC_DAC_DRC_CTRL — DAC DRC Control Register
0x10C AC_DAC_DRC_LPFHAT — DAC DRC Left Peak Filter High Attack Time Coef Register
0x110 AC_DAC_DRC_LPFLAT — DAC DRC Left Peak Filter Low Attack Time Coef Register
0x114 AC_DAC_DRC_RPFHAT — DAC DRC Right Peak Filter High Attack Time Coef Register
0x118 AC_DAC_DRC_RPFLAT — DAC DRC Peak Filter Low Attack Time Coef Register
0x11C AC_DAC_DRC_LPFHRT — DAC DRC Left Peak Filter High Release Time Coef Register
0x120 AC_DAC_DRC_LPFLRT — DAC DRC Left Peak Filter Low Release Time Coef Register
0x124 AC_DAC_DRC_RPFHRT — DAC DRC Right Peak filter High Release Time Coef Register
0x128 AC_DAC_DRC_RPFLRT — DAC DRC Right Peak filter Low Release Time Coef Register
0x12C AC_DAC_DRC_LRMSHAT — DAC DRC Left RMS Filter High Coef Register
0x130 AC_DAC_DRC_LRMSLAT — DAC DRC Left RMS Filter Low Coef Register
0x134 AC_DAC_DRC_RRMSHAT — DAC DRC Right RMS Filter High Coef Register
0x138 AC_DAC_DRC_RRMSLAT — DAC DRC Right RMS Filter Low Coef Register
0x13C AC_DAC_DRC_HCT — DAC DRC Compressor Threshold High Setting Register
0x140 AC_DAC_DRC_LCT — DAC DRC Compressor Slope High Setting Register
0x144 AC_DAC_DRC_HKC — DAC DRC Compressor Slope High Setting Register
0x148 AC_DAC_DRC_LKC — DAC DRC Compressor Slope Low Setting Register
0x14C AC_DAC_DRC_HOPC — DAC DRC Compressor High Output at Compressor Threshold Register
0x150 AC_DAC_DRC_LOPC — DAC DRC Compressor Low Output at Compressor Threshold Register
0x154 AC_DAC_DRC_HLT — DAC DRC Limiter Threshold High Setting Register
0x158 AC_DAC_DRC_LLT — DAC DRC Limiter Threshold Low Setting Register
0x15C AC_DAC_DRC_HKl — DAC DRC Limiter Slope High Setting Register
0x160 AC_DAC_DRC_LKl — DAC DRC Limiter Slope Low Setting Register
0x164 AC_DAC_DRC_HOPL — DAC DRC Limiter High Output at Limiter Threshold
0x168 AC_DAC_DRC_LOPL — DAC DRC Limiter Low Output at Limiter Threshold
0x16C AC_DAC_DRC_HET — DAC DRC Expander Threshold High Setting Register
0x170 AC_DAC_DRC_LET — DAC DRC Expander Threshold Low Setting Register
0x174 AC_DAC_DRC_HKE — DAC DRC Expander Slope High Setting Register
0x178 AC_DAC_DRC_LKE — DAC DRC Expander Slope Low Setting Register
0x17C AC_DAC_DRC_HOPE — DAC DRC Expander High Output at Expander Threshold
0x180 AC_DAC_DRC_LOPE — DAC DRC Expander Low Output at Expander Threshold
0x184 AC_DAC_DRC_HKN — DAC DRC Linear Slope High Setting Register
0x188 AC_DAC_DRC_LKN — DAC DRC Linear Slope Low Setting Register
0x18C AC_DAC_DRC_SFHAT — DAC DRC Smooth filter Gain High Attack Time Coef Register
0x190 AC_DAC_DRC_SFLAT — DAC DRC Smooth filter Gain Low Attack Time Coef Register
0x194 AC_DAC_DRC_SFHRT — DAC DRC Smooth filter Gain High Release Time Coef Register
0x198 AC_DAC_DRC_SFLRT — DAC DRC Smooth filter Gain Low Release Time Coef Register
0x19C AC_DAC_DRC_MXGHS — DAC DRC MAX Gain High Setting Register
0x1A0 AC_DAC_DRC_MXGLS — DAC DRC MAX Gain Low Setting Register
0x1A4 AC_DAC_DRC_MNGHS — DAC DRC MIN Gain High Setting Register
0x1A8 AC_DAC_DRC_MNGLS — DAC DRC MIN Gain Low Setting Register
0x1AC AC_DAC_DRC_EPSHC — DAC DRC Expander Smooth Time High Coef Register
0x1B0 AC_DAC_DRC_EPSLC — DAC DRC Expander Smooth Time Low Coef Register
0x1B8 AC_DAC_DRC_HPFHGAIN — DAC DRC HPF Gain High Coef Register
0x1BC AC_DAC_DRC_HPFLGAIN — DAC DRC HPF Gain Low Coef Register
0x200 AC_ADC_DRC_HHPFC — ADC DRC High HPF Coef Register
0x204 AC_ADC_DRC_LHPFC — ADC DRC Low HPF Coef Register
0x208 AC_ADC_DRC_CTRL — ADC DRC Control Register
0x20C AC_ADC_DRC_LPFHAT — ADC DRC Left Peak Filter High Attack Time Coef Register
0x210 AC_ADC_DRC_LPFLAT — ADC DRC Left Peak Filter Low Attack Time Coef Register
0x214 AC_ADC_DRC_RPFHAT — ADC DRC Right Peak Filter High Attack Time Coef Register
0x218 AC_ADC_DRC_RPFLAT — ADC DRC Right Peak Filter Low Attack Time Coef Register
0x21C AC_ADC_DRC_LPFHRT — ADC DRC Left Peak Filter High Release Time Coef Register
0x220 AC_ADC_DRC_LPFLRT — ADC DRC Left Peak Filter Low Release Time Coef Register
0x224 AC_ADC_DRC_RPFHRT — ADC DRC Right Peak Filter High Release Time Coef Register
0x228 AC_ADC_DRC_RPFLRT — ADC DRC Right Peak Filter Low Release Time Coef Register
0x22C AC_ADC_DRC_LRMSHAT — ADC DRC Left RMS Filter High Coef Register
0x230 AC_ADC_DRC_LRMSLAT — ADC DRC Left RMS Filter Low Coef Register
0x234 AC_ADC_DRC_RRMSHAT — ADC DRC Right RMS Filter High Coef Register
0x238 AC_ADC_DRC_RRMSLAT — ADC DRC Right RMS Filter Low Coef Register
0x23C AC_ADC_DRC_HCT — ADC DRC Compressor Threshold High Setting Register
0x240 AC_ADC_DRC_LCT — ADC DRC Compressor Slope High Setting Register
0x244 AC_ADC_DRC_HKC — ADC DRC Compressor Slope High Setting Register
0x248 AC_ADC_DRC_LKC — ADC DRC Compressor Slope Low Setting Register
0x24C AC_ADC_DRC_HOPC — ADC DRC Compressor High Output at Compressor Threshold Register
0x250 AC_ADC_DRC_LOPC — ADC DRC Compressor Low Output at Compressor Threshold Register
0x254 AC_ADC_DRC_HLT — ADC DRC Limiter Threshold High Setting Register
0x258 AC_ADC_DRC_LLT — ADC DRC Limiter Threshold Low Setting Register
0x25C AC_ADC_DRC_HKl — ADC DRC Limiter Slope High Setting Register
0x260 AC_ADC_DRC_LKl — ADC DRC Limiter Slope Low Setting Register
0x264 AC_ADC_DRC_HOPL — ADC DRC Limiter High Output at Limiter Threshold
0x268 AC_ADC_DRC_LOPL — ADC DRC Limiter Low Output at Limiter Threshold
0x26C AC_ADC_DRC_HET — ADC DRC Expander Threshold High Setting Register
0x270 AC_ADC_DRC_LET — ADC DRC Expander Threshold Low Setting Register
0x274 AC_ADC_DRC_HKE — ADC DRC Expander Slope High Setting Register
0x278 AC_ADC_DRC_LKE — ADC DRC Expander Slope Low Setting Register
0x27C AC_ADC_DRC_HOPE — ADC DRC Expander High Output at Expander Threshold
0x280 AC_ADC_DRC_LOPE — ADC DRC Expander Low Output at Expander Threshold
0x284 AC_ADC_DRC_HKN — ADC DRC Linear Slope High Setting Register
0x288 AC_ADC_DRC_LKN — ADC DRC Linear Slope Low Setting Register
0x28C AC_ADC_DRC_SFHAT — ADC DRC Smooth filter Gain High Attack Time Coef Register
0x290 AC_ADC_DRC_SFLAT — ADC DRC Smooth filter Gain Low Attack Time Coef Register
0x294 AC_ADC_DRC_SFHRT — ADC DRC Smooth filter Gain High Release Time Coef Register
0x298 AC_ADC_DRC_SFLRT — ADC DRC Smooth filter Gain Low Release Time Coef Register
0x29C AC_ADC_DRC_MXGHS — ADC DRC MAX Gain High Setting Register
0x2A0 AC_ADC_DRC_MXGLS — ADC DRC MAX Gain Low Setting Register
0x2A4 AC_ADC_DRC_MNGHS — ADC DRC MIN Gain High Setting Register
0x2A8 AC_ADC_DRC_MNGLS — ADC DRC MIN Gain Low Setting Register
0x2AC AC_ADC_DRC_EPSHC — ADC DRC Expander Smooth Time High Coef Register
0x2B0 AC_ADC_DRC_EPSLC — ADC DRC Expander Smooth Time Low Coef Register
0x2B8 AC_ADC_DRC_HPFHGAIN — ADC DRC HPF Gain High Coef Register
0x2BC AC_ADC_DRC_HPFLGAIN — ADC DRC HPF Gain Low Coef Register
{0x2FC+4i} ADC{i}_REG (i=1..3) — ADC{i} Analog Control Register
0x310 DAC_REG — DAC Analog Control Register
0x318 MICBIAS_REG — MICBIAS Analog Control Register
0x31C RAMP_REG — BIAS Analog Control Register
0x320 BIAS_REG — BIAS Analog Control Register
0x330 ADC5_REG — ADC5 Analog Control Register
