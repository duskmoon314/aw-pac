# allwinner_d1_unofficial register map
File version: 0.1
Registers are 32-bit, read-write, reset 0x0 unless marked. A register's access mark holds for its fields unless they carry their own. Offsets are from the block's base; [hi:lo] are bit positions; {n}, {i} and the like mark numbered series.

## LEDC
Base 0x02008000
0x00 LEDC_CTRL — LEDC Control Register
0x04 LED_T01_TIMING_CTRL — LEDC T0 T1 Timing Control Register
0x08 LEDC_DATA_FINISH_CNT — LEDC Data Finish Counter Register
0x0C LED_RESET_TIMING_CTRL — LEDC Reset Timing Control Register
0x10 LEDC_WAIT_TIME0_CTRL — LEDC Wait Time0 Control Register
0x14 LEDC_DATA
0x18 LEDC_DMA_CTRL — LEDC DMA Control Register
0x1C LEDC_INT_CTRL — LEDC Interrupt Control Register
0x20 LEDC_INT_STS — LEDC Interrupt Status Register
0x28 LEDC_WAIT_TIME1_CTRL — LEDC Wait Time1 Control Register
{0x30+4i} LEDC_FIFO_DATA{i} (i=0..31) ro

## EMAC — Ethernet Medium Access Controller
Base 0x04500000
0x00 EMAC_BASIC_CTL0 — EMAC Basic Control Register0
0x04 EMAC_BASIC_CTL1 — EMAC Basic Control Register1
0x08 EMAC_INT_STA — EMAC Interrupt Status Register
0x0C EMAC_INT_EN — EMAC Interrupt Enable Register
0x10 EMAC_TX_CTL0 — EMAC Transmit Control Register0
0x14 EMAC_TX_CTL1 — EMAC Transmit Control Register1
0x1C EMAC_TX_FLOW_CTL — EMAC Transmit Flow Control Register
0x20 EMAC_TX_DMA_DESC_LIST — EMAC Transmit Descriptor List Address Register
0x24 EMAC_RX_CTL0 — EMAC Receive Control Register0
0x28 EMAC_RX_CTL1 — EMAC Receive Control Register1
0x34 EMAC_RX_DMA_DESC_LIST — EMAC Receive Descriptor List Address Register
0x38 EMAC_RX_FRM_FLT — EMAC Receive Frame Filter Register
0x40 EMAC_RX_HASH0 — EMAC Hash Table Register0
0x44 EMAC_RX_HASH1 — EMAC Hash Table Register1
0x48 EMAC_MII_CMD — EMAC Management Interface Command Register
0x4C EMAC_MII_DATA — EMAC Management Interface Data Register
{0x50+8i} EMAC_ADDR_HIGH{i} (i=0..7) — EMAC MAC Address High Register
{0x54+8i} EMAC_ADDR_LOW{i} (i=0..7) — EMAC MAC Address Low Register
0xB0 EMAC_TX_DMA_STA — EMAC Transmit DMA Status Register
0xB4 EMAC_TX_CUR_DESC — EMAC Current Transmit Descriptor Register
0xB8 EMAC_TX_CUR_BUF — EMAC Current Transmit Buffer Address Register
0xC0 EMAC_RX_DMA_STA — EMAC Receive DMA Status Register
0xC4 EMAC_RX_CUR_DESC — EMAC Current Receive Descriptor Register
0xC8 EMAC_RX_CUR_BUF — EMAC Current Receive Buffer Address Register
0xD0 EMAC_RGMII_STA — EMAC RGMII Status Register

## CIR_RX — Counsumer Infrared Receiver
Base 0x07040000
0x00 CIR_CTL — CIR Control Register
0x10 CIR_RXPCFG — CIR Receiver Pulse Configure Register
0x20 CIR_RXFIFO — CIR Receiver FIFO Register
0x2C CIR_RXINT — CIR Receiver Interrupt Control Register
0x30 CIR_RXSTA — CIR Receiver Status Register
0x34 CIR_RXCFG — CIR Receiver Configure Register

## CIR_TX — Counsumer Infrared Transmitter
Base 0x02003000
0x00 CIR_TGLR — CIR Transmit Global Register
0x04 CIR_TMCR — CIR Transmit Modulation Control Register
0x08 CIR_TCR — CIR Transmit Control Register
0x0C CIR_IDC_H — CIR Transmit Idle Duration Threshold High Bit Register
0x10 CIR_IDC_L — CIR Transmit Idle Duration Threshold Low Bit Register
0x14 CIR_TICR_H — CIR Transmit Idle Counter High Bit Register
0x18 CIR_TICR_L — CIR Transmit Idle Counter Low Bit Register
0x20 CIR_TEL — CIR TX FIFO Empty Level Register
0x24 CIR_TXINT — CIR Transmit Interrupt Control Register
0x28 CIR_TAC — CIR Transmit FIFO Available Counter Register
0x2C CIR_TXSTA — CIR Transmit Status Register
0x30 CIR_TXT — CIR Transmit Threshold Register
0x34 CIR_DMA — CIR DMA Control Register
0x80 CIR_TXFIFO — CIR Transmit FIFO Data Register

## CE_NS — Crypoto Engine
Base 0x03040000
0x00 CE_TDA — Task Descriptor Address
0x08 CE_ICR — Interrupt Control Register
0x0C CE_ISR — Interrupt Status Register
0x10 CE_TLR — Task Load Register
0x14 CE_TSR — Task Status Register
0x18 CE_ESR — Error Status Register
0x24 CE_CSA — DMA Current Source Address
0x28 CE_CDA — DMA Current Destination Address
0x2C CE_TPR — Throughput Register
