# allwinner_d1_unofficial register map
File version: 0.1
Registers are 32-bit, read-write, reset 0x0 unless marked. A register's access mark holds for its fields unless they carry their own. Offsets are from the block's base; [hi:lo] are bit positions; lines under a group give offsets from that group; {n}, {i} and the like mark numbered series; 'fields as' and 'values as' point back to an identical list.

## PLIC — Platform Level Interrupt Control
Base 0x10000000
{0x0+4i} prio[{i}] (i=0..255) — Interrupt Priority Register
  [4:0] priority
    0=P0 (Priority 0 (never interrupt)); {v}=P{v} (Priority {v}) (v=1..31)
{0x1000+4i} ip[{i}] (i=0..8) — Interrupt Pending Register
{0x2000+4i} mie[{i}] (i=0..8) — Machine Mode Interrupt Enable Register
{0x2080+4i} sie[{i}] (i=0..8) — Supervisor Mode Interrupt Enable Register
0x1FFFFC ctrl — Control Register
  [0] ctrl — PLIC Control
    0=m (Only the machine mode can access to all registers in PLIC. Supervisor mode can only access the interrupt threshold register and the interrupt response/completion register.); 1=ms (The machine mode and the supervisor mode can access all registers. CTRL is accessible only in the machine mode.)
0x200000 mth — Machine Mode Priority Threshold Register
  fields as prio[0]
0x200004 mclaim — Machine Mode Claim/Complete Register
  [9:0] mclaim
0x201000 sth — Supervisor Mode Priority Threshold Register
  fields as prio[0]
0x201004 sclaim — Supervisor Mode Claim/Complete Register
  [9:0] sclaim

## DMAC — Direct Memory Access Controller
Base 0x03002000
0x00 DMAC_IRQ_EN_REG0 — DMAC IRQ Enable Register 0
0x04 DMAC_IRQ_EN_REG1 — DMAC IRQ Enable Register 1
0x10 DMAC_IRQ_PEND_REG0 — DMAC IRQ Pending Register 0
0x14 DMAC_IRQ_PEND_REG1 — DMAC IRQ Pending Register 1
0x28 DMAC_AUTO_GATE_REG — DMAC Auto Gating Register
0x30 DMAC_STA_REG — DMAC Status Register
{0x100+0x40*i} DMAC_EN_REG{i} (i=0..15) — DMAC Channel Enable Register
{0x104+0x40*i} DMAC_PAU_REG{i} (i=0..15) — DMAC Channel Pause Register
{0x108+0x40*i} DMAC_DESC_ADDR_REG{i} (i=0..15) — DMAC Channel Start Address Register
{0x10C+0x40*i} DMAC_CFG_REG{i} (i=0..15) — DMAC Channel Configuration Register
{0x110+0x40*i} DMAC_CUR_SRC_REG{i} (i=0..15) — DMAC Channel Current Source Register
{0x114+0x40*i} DMAC_CUR_DEST_REG{i} (i=0..15) — DMAC Channel Current Destination Register
{0x118+0x40*i} DMAC_BCNT_LEFT_REG{i} (i=0..15) — DMAC Channel Byte Counter Left Register
{0x11C+0x40*i} DMAC_PARA_REG{i} (i=0..15) — DMAC Channel Parameter Register
{0x128+0x40*i} DMAC_MODE_REG{i} (i=0..15) — DMAC Mode Register
{0x12C+0x40*i} DMAC_FDESC_ADDR_REG{i} (i=0..15) — DMAC Former Descriptor Address Register
{0x130+0x40*i} DMAC_PKG_NUM_REG{i} (i=0..15) — DMAC Package Number Register

## THC — Thermal Sensor Controller
Base 0x02009400
0x00 THS_CTRL — THS Control Register
0x04 THS_EN — THS Enable Register
0x08 THS_PER — THS Period Control Register
0x10 THS_DATA_INTC — THS Data Interrupt Control Register
0x14 THS_SHUT_INTC — THS Shut Interrupt Control Register
0x18 THS_ALARM_INTC — THS Alarm Interrupt Control Register
0x20 THS_DATA_INTS — THS Data Interrupt Status Register
0x24 THS_SHUT_INTS — THS Shut Interrupt Status Register
0x28 THS_ALARMO_INTS — THS Alarm off Interrupt Status Register
0x2C THS_ALARM_INTS — THS Alarm Interrupt Status Register
0x30 THS_FILTER — THS Median Filter Control Register
0x40 THS_ALARM_CTRL — THS Alarm Threshold Control Register
0x80 THS_SHUTDOWN_CTRL — THS Shutdown Threshold Control Register
0xA0 THS_CDATA — THS Calibration Data
0xC0 THS_DATA

## DSP_MSGBOX — DSP Message Box
Base 0x01701000
Same registers: RISC_V_MSGBOX 0x0601F000
{0x20+0x100*i} MSGBOX_RD_IRQ_EN_REG_{i} (i=0..1) — MSGBOX Read IRQ Enable Register
{0x24+0x100*i} MSGBOX_RD_IRQ_STATUS_REG_{i} (i=0..1) — MSGBOX Read IRQ Status Register
{0x30+0x100*i} MSGBOX_WR_IRQ_EN_REG_{i} (i=0..1) — MSGBOX Write IRQ Enable Register
{0x34+0x100*i} MSGBOX_WR_IRQ_STATUS_REG_{i} (i=0..1) — MSGBOX Write IRQ Status Register
{0x40+0x100*i} MSGBOX_DEBUG_REG_{i} (i=0..1) — MSGBOX Debug Register
{0x50+0x100*i} MSGBOX_FIFO_STATUS_REG_N{i} (i=0..1) group — MSGBOX FIFO Status Register
  {0x0+4j} MSGBOX_FIFO_STATUS_REG_P{j} (j=0..2) — MSGBOX FIFO Status Register
{0x60+0x100*i} MSGBOX_MSG_STATUS_REG_N{i} (i=0..1) group — MSGBOX Message Status Register
  {0x0+4j} MSGBOX_MSG_STATUS_REG_P{j} (j=0..2) — MSGBOX Message Status Register
{0x70+0x100*i} MSGBOX_MSG_REG_N{i} (i=0..1) group — MSGBOX Message Queue Register
  {0x0+4j} MSGBOX_MSG_REG_P{j} (j=0..2) — MSGBOX Message Queue Register
{0x80+0x100*i} MSGBOX_WR_INT_THRESHOLD_REG_N{i} (i=0..1) group — MSGBOX Write IRQ Threshold Register
  {0x0+4j} MSGBOX_WR_INT_THRESHOLD_REG_P{j} (j=0..2) — MSGBOX Write IRQ Threshold Register
