# allwinner_d1_unofficial register map
File version: 0.1
Registers are 32-bit, read-write, reset 0x0 unless marked. A register's access mark holds for its fields unless they carry their own. Offsets are from the block's base; [hi:lo] are bit positions; {n}, {i} and the like mark numbered series.

## TCON_TV0 — Timing COntroller TV
Base 0x05470000
0x00 TV_GCTL_REG — TV Global Control Register
0x04 TV_GINT0_REG — TV Global Interrupt Register0
0x08 TV_GINT1_REG — TV Global Interrupt Register1
0x40 TV_SRC_CTL_REG — TV Source Control Register
0x88 TV_IO_POL_REG — TV SYNC Signal Polarity Register
0x8C TV_IO_TRI_REG — TV SYNC Signal IO Control Register
0x90 TV_CTL_REG — TV Control Register
{0x94+4i} TV_BASIC{i}_REG (i=0..5) — TV Basic Timing Register{i}
0xFC TV_DEBUG_REG — TV Debug Register
0x100 TV_CEU_CTL_REG — TV CEU Control Register
{0x110+4i} TV_CEU_COEF_MUL_REG{i} (i=0..10) — TV CEU Coefficient Register0
{0x140+4i} TV_CEU_COEF_RANG_REG{i} (i=0..2) — TV CEU Coefficient Register2
0x1F0 TV_SAFE_PERIOD_REG — TV Safe Period Register
0x300 TV_FILL_CTL_REG — TV Fill Data Control Register
{0x304+0xC*i} TV_FILL_BEGIN_REG{i} (i=0..2) — TV Fill Data Begin Register
{0x308+0xC*i} TV_FILL_END_REG{i} (i=0..2) — TV Fill Data End Register
{0x30C+0xC*i} TV_FILL_DATA_REG{i} (i=0..2) — TV Fill Data Value Register
0x330 TV_DATA_IO_POL0_REG — TCON Data IO Polarity Control0
0x334 TV_DATA_IO_POL1_REG — TCON Data IO Polarity Control1
0x338 TV_DATA_IO_TRI0_REG — TCON Data IO Enable Control0
0x33C TV_DATA_IO_TRI1_REG — TCON Data IO Enable Control1
0x340 TV_PIXELDEPTH_MODE_REG — TV Pixeldepth Mode Control Register

## TVE_TOP — TV Encoder TOP
Base 0x05600000
0x20 TVE_DAC_MAP — TV Encoder DAC MAP Register
0x24 TVE_DAC_STATUS — TV Encoder DAC STAUTS Register
{0x28+4i} TVE_DAC_CFG{i} (i=0..2) — TV Encoder DAC CFG{i} Register
0x34 TVE_DAC_CFG3 — TV Encoder DAC CFG2 Register
0xF0 TVE_DAC_TEST — TV Encoder DAC TEST Register

## TVE — TV Encoder
Base 0x05604000
0x00 TVE_000_REG — TV Encoder Clock Gating Register
0x04 TVE_004_REG — TV Encoder Configuration Register
0x08 TVE_008_REG — TV Encoder DAC Register1
0x0C TVE_00C_REG — TV Encoder Notch and DAC Delay Register
0x10 TVE_010_REG — TV Encoder Chroma Frequency Register
0x14 TVE_014_REG — TV Encoder Front/Back Porch Register
0x18 TVE_018_REG — TV Encoder HD Mode VSYNC Register
0x1C TVE_01C_REG — TV Encoder Line Number Register
0x20 TVE_020_REG — TV Encoder Level Register
0x24 TVE_024_REG — TV Encoder DAC Register2
0x30 TVE_030_REG — TV Encoder Auto Detection Enable Register
0x34 TVE_034_REG — TV Encoder Auto Detection Interrupt Status Register
0x38 TVE_038_REG — TV Encoder Auto Detection Status Register
0x3C TVE_03C_REG — TV Encoder Auto Detection De-bounce Setting Register
0xF8 TVE_0F8_REG — TV Encoder Auto Detect Configuration Register0
0xFC TVE_0FC_REG — TV Encoder Auto Detect Configuration Register1
0x100 TVE_100_REG — TV Encoder Color Burst Phase Reset Configuration Register
0x104 TVE_104_REG — TV Encoder VSYNC Number Register
0x108 TVE_108_REG — TV Encoder Notch Filter Frequency Register
0x10C TVE_10C_REG — TV Encoder Cb/Cr Level/Gain Register
0x110 TVE_110_REG — TV Encoder Tint and Color Burst Phase Register
0x114 TVE_114_REG — TV Encoder Burst Width Register
0x118 TVE_118_REG — TV Encoder Cb/Cr Gain Register
0x11C TVE_11C_REG — TV Encoder Sync and VBI Level Register
0x120 TVE_120_REG — TV Encoder White Level Register
0x124 TVE_124_REG — TV Encoder Video Active Line Register
0x128 TVE_128_REG — TV Encoder Video Chroma BW and CompGain Register
0x12C TVE_12C_REG — TV Encoder Register
0x130 TVE_130_REG — TV Encoder Re-sync Parameters Register
0x134 TVE_134_REG — TV Encoder Slave Parameter Register
0x138 TVE_138_REG — TV Encoder Configuration Register0
0x13C TVE_13C_REG — TV Encoder Configuration Register1
0x380 TVE_380_REG — TV Encoder Low Pass Control Register
0x384 TVE_384_REG — TV Encoder Low Pass Filter Control Register

## TVD_TOP — Television Decoder TOP
Base 0x05C00000
0x00 TVD_TOP_MAP
{0x4+4i} TVD_3D_CTL{i} (i=1..5) — TVD 3D DMA CONTROL Register{i}
{0x24+0x20*i} TVD_TOP_CTL{i} (i=0..3) — TVD TOP CONTROL Register
{0x28+0x20*i} TVD_ADC_CTL{i} (i=0..3) — TVD ADC CONTROL Register
{0x2C+0x20*i} TVD_ADC_CFG{i} (i=0..3) — TVD ADC CONFIGURATION Register
