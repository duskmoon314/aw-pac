# allwinner_d1_unofficial register map
File version: 0.1
Registers are 32-bit, read-write, reset 0x0 unless marked. A register's access mark holds for its fields unless they carry their own. Offsets are from the block's base; [hi:lo] are bit positions; lines under a group give offsets from that group; {n}, {i} and the like mark numbered series.

## CSIC — CMOS Sensor Interface Controller
Base 0x05800000
0x00 CSIC_CCU group
  0x00 CCU_CLK_MODE_REG — CCU Clock Mode Register
  0x04 CCU_PARSER_CLK_EN_REG — CCU Parser Clock Enable Register
  0x0C CCU_POST0_CLK_EN_REG — CCU Post0 Clock Enable Register
0x800 CSIC_TOP group
  0x00 CSIC_TOP_EN_REG — CSIC TOP Enable Register
  0x04 CSIC_PTN_GEN_EN_REG — CSIC Pattern Generation Enable Register
  0x08 CSIC_PTN_CTRL_REG — CSIC Pattern Control Register
  0x20 CSIC_PTN_LEN_REG — CSIC Pattern Generation Length Register
  0x24 CSIC_PTN_ADDR_REG — CSIC Pattern Generation Address Register
  0x28 CSIC_PTN_ISP_SIZE_REG — CSIC Pattern ISP Size Register
  0xA0 CSIC_DMA0_INPUT_SEL_REG — CSIC DMA0 Input Select Register
  0xA4 CSIC_DMA1_INPUT_SEL_REG — CSIC DMA1 Input Select Register
  0xDC CSIC_BIST_CS_REG — CSIC BIST CS Register
  0xE0 CSIC_BIST_CONTROL_REG — CSIC BIST Control Register
  0xE4 CSIC_BIST_START_REG — CSIC BIST Start Register
  0xE8 CSIC_BIST_END_REG — CSIC BIST End Register
  0xEC CSIC_BIST_DATA_MASK_REG — CSIC BIST Data Mask Register
  0xF0 CSIC_MBUS_REQ_MAX_REG — CSIC MBUS REQ MAX Register
  0x100 CSIC_MULF_MOD_REG — CSIC Multi-Frame Mode Register
  0x104 CSIC_MULF_INT_REG — CSIC Multi-Frame Interrupt Register
0x1000 CSIC_PARSER0 group
  0x00 PRS_EN_REG — Parser Enable Register
  0x04 PRS_NCSIC_IF_CFG_REG — Parser NCSIC Interface Configuration Register
  0x0C PRS_CAP_REG — Parser Capture Register
  0x10 CSIC_PRS_SIGNAL_STA_REG — CSIC Parser Signal Status Register
  0x14 CSIC_PRS_NCSIC_BT656_HEAD_CFG_REG — CSIC Parser NCSIC BT656 Header Configuration Register
  {0x24+0x100*j} PRS_C{j}_INFMT_REG (j=0..3) — Parser Channel_{j} Input Format Register
  0x28 PRS_C0_OUTPUT_HSIZE_REG — Parser Channel_0 Output Horizontal Size Register
  {0x2C+0x100*j} PRS_C{j}_OUTPUT_VSIZE_REG (j=0..3) — Parser Channel_{j} Output Vertical Size Register
  {0x30+0x100*j} PRS_C{j}_INPUT_PARA0_REG (j=0..3) — Parser Channel_{j} Input Parameter0 Register
  {0x34+0x100*j} PRS_C{j}_INPUT_PARA1_REG (j=0..3) — Parser Channel_{j} Input Parameter1 Register
  {0x38+0x100*j} PRS_C{j}_INPUT_PARA2_REG (j=0..3) — Parser Channel_{j} Input Parameter2 Register
  {0x3C+0x100*j} PRS_C{j}_INPUT_PARA3_REG (j=0..3) — Parser Channel_{j} Input Parameter3 Register
  {0x40+0x100*j} PRS_C{j}_INT_EN_REG (j=0..3) — Parser Channel_{j} Interrupt Enable Register
  {0x44+0x100*j} PRS_C{j}_INT_STA_REG (j=0..3) — Parser Channel_{j} Interrupt Status Register
  {0x48+0x100*j} PRS_CH{j}_LINE_TIME_REG (j=0..3) — Parser Channel_{j} Line Time Register
  0x128 PRS_C1_OUTPUT_HSIZE_REG — Parser Channel_1 Output Horizontal Size
  0x228 PRS_C2_OUTPUT_HSIZE_REG — Parser Channel_2 Output Horizontal Size Register
  0x328 PRS_C3_OUTPUT_HSIZE_REG — Parser Channel_3 Output Horizontal Size Register
  0x500 CSIC_PRS_NCSIC_RX_SIGNAL0_DLY_ADJ_REG — CSIC Parser NCSIC RX Signal0 Delay Adjust Register
  0x514 CSIC_PRS_NCSIC_RX_SIGNAL5_DLY_ADJ_REG — CSIC Parser NCSIC RX Signal5 Delay Adjust Register
  0x518 CSIC_PRS_NCSIC_RX_SIGNAL6_DLY_ADJ_REG — CSIC Parser NCSIC RX Signal6 Delay Adjust Register
{0x9000+0x200*i} CSIC_DMA{i} (i=0..1) group
  0x00 CSIC_DMA_EN_REG — CSIC DMA Enable Register
  0x04 CSIC_DMA_CFG_REG — CSIC DMA Configuration Register
  0x10 CSIC_DMA_HSIZE_REG — CSIC DMA Horizontal Size Register
  0x14 CSIC_DMA_VSIZE_REG — CSIC DMA Vertical Size Register
  {0x20+8j} CSIC_DMA_F{j}_BUFA_REG (j=0..2) — CSIC DMA FIFO {j} Output Buffer-A Address Register
  {0x24+8j} CSIC_DMA_F{j}_BUFA_RESULT_REG (j=0..2) — CSIC DMA FIFO {j} Output Buffer-A Address Result Register
  0x38 CSIC_DMA_BUF_LEN_REG — CSIC DMA Buffer Length Register
  0x3C CSIC_DMA_FLIP_SIZE_REG — CSIC DMA Flip Size Register
  0x40 CSIC_DMA_VI_TO_TH0_REG — CSIC DMA Video Input Timeout Threshold0 Register
  0x44 CSIC_DMA_VI_TO_TH1_REG — CSIC DMA Video Input Timeout Threshold1 Register
  0x48 CSIC_DMA_VI_TO_CNT_VAL_REG — CSIC DMA Video Input Timeout Counter Value Register
  0x4C CSIC_DMA_CAP_STA_REG — CSIC DMA Capture Status Register
  0x50 CSIC_DMA_INT_EN_REG — CSIC DMA Interrupt Enable Register
  0x54 CSIC_DMA_INT_STA_REG — CSIC DMA Interrupt Status Register
  0x58 CSIC_DMA_LINE_CNT_REG — CSIC DMA LINE Counter Register
  0x5C CSIC_DMA_FRM_CNT_REG — CSIC DMA Frame Counter Register
  0x60 CSIC_DMA_FRM_CLK_CNT_REG — CSIC DMA Frame Clock Counter Register
  0x64 CSIC_DMA_ACC_ITNL_CLK_CNT_REG — CSIC DMA Accumulated And Internal Clock Counter Register
  0x68 CSIC_DMA_FIFO_STAT_REG — CSIC DMA FIFO Statistic Register
  0x6C CSIC_DMA_FIFO_THRS_REG — CSIC DMA FIFO Threshold Register
  0x70 CSIC_DMA_PCLK_STAT_REG — CSIC DMA PCLK Statistic Register
  {0x80+4j} CSIC_DMA_BUF_ADDR_FIFO{j}_ENTRY_REG (j=0..2) — CSIC DMA BUF Address FIFO{j} Entry Register
  0x8C CSIC_DMA_BUF_TH_REG — CSIC DMA BUF Threshold Register
  0x90 CSIC_DMA_BUF_ADDR_FIFO_CON_REG — CSIC DMA BUF Address FIFO Content Register
  0x94 CSIC_DMA_STORED_FRM_CNT_REG — CSIC DMA Stored Frame Counter Register
  0x1F4 CSIC_FEATURE_REG — CSIC DMA Feature List Register
